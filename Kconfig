## Kconfig
```kconfig
menuconfig SEP3_ZEPHYR
    bool "SEP3 blocking wrapper for Zephyr async UART"
    default n
    depends on SERIAL
    depends on UART_ASYNC_API
    select CRC

if SEP3_ZEPHYR

config SEP3_ZEPHYR_MAX_INSTANCES
    int "Maximum wrapper instances per boot"
    range 1 16
    default 4

config SEP3_MAX_PAYLOAD_SIZE
    int "Maximum SEP3 payload size"
    range 64 2046
    default 244
    help
      Maximum application payload accepted by sep3-c. Packet and encoded
      frame sizes are derived from this value. Outside Zephyr the same value
      must be provided as CONFIG_SEP3_MAX_PAYLOAD_SIZE by the build system.

config SEP3_ZEPHYR_ENDPOINT_CAPACITY
    int "Maximum endpoint count per instance"
    range 1 240
    default 8

config SEP3_ZEPHYR_THREAD_STACK_SIZE
    int "Owner thread stack size"
    range 1024 65535
    default 2048
    help
      Large SEP3_MAX_PAYLOAD_SIZE can increase stack usage in application
      callbacks. Raise this value when using payloads significantly larger
      than 244 bytes.

config SEP3_ZEPHYR_THREAD_PRIORITY
    int "Owner thread priority"
    range 0 15
    default 5

config SEP3_ZEPHYR_COMMAND_QUEUE_SIZE
    int "Pending command queue size"
    range 2 64
    default 8

config SEP3_ZEPHYR_RX_RING_SIZE
    int "Received byte ring size"
    range 290 8192
    default 290
    help
      Must be at least SEP3_MAX_ENCODED_FRAME_SIZE derived from
      SEP3_MAX_PAYLOAD_SIZE. The default holds one encoded packet with a
      244-byte payload. Larger values reduce the risk of RX overrun.

config SEP3_ZEPHYR_RX_BUFFER_SIZE
    int "UART DMA receive buffer size"
    range 64 4096
    default 64

config SEP3_ZEPHYR_PROCESS_PERIOD_MS
    int "Maximum protocol processing period"
    range 1 1000
    default 10

endif
```

## tests/testcase.yaml
```yaml
common:
  harness: ztest
  tags:
    - lib
    - sep3
    - uart
  platform_allow:
    - native_sim/native/64

tests:
  lib.sep3_zephyr.uart_emul: {}
```
